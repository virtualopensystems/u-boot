/dts-v1/;

/include/ "coreboot.dtsi"
/include/ "chromeos-coreboot.dtsi"
/include/ "flashmap-coreboot-8mb.dtsi"

/ {
	model = "Google Lumpy";
	compatible = "google,lumpy", "intel,celeron-sandybridge";

	config {
		hwid = "X86 LUMPY TEST 6638";
		hda_codec_beep = <1>;
	};
};
