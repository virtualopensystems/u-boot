/dts-v1/;

/include/ "skeleton.dtsi"
/include/ "chromeos.dtsi"
/include/ "flashmap-4mb.dtsi"

/ {
	model = "Google Alex";
	compatible = "google,alex", "intel,atom-pineview";

	config {
	       silent_console = <0>;
	       hwid = "X86 ALEX TEST 9769";
	};

	aliases {
		console = "/serial";
	};

	serial {
	};
};
