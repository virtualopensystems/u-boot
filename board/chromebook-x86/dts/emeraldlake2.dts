/dts-v1/;

/include/ "coreboot.dtsi"
/include/ "chromeos.dtsi"
/include/ "flashmap-8mb_1mbRom.dtsi"

/ {
	model = "Intel Emerald Lake 2";
	compatible = "intel,emerald-lake-2", "intel,celeron-ivybridge";

	config {
		hwid = "X86 EMERALD LAKE 2 TEST 6638";
		usb-keyboard;
	};
};
