/dts-v1/;

/include/ "coreboot.dtsi"
/include/ "chromeos-coreboot.dtsi"
/include/ "flashmap-coreboot-8mb_1mb_rom.dtsi"

/ {
	model = "Google Stout";
	compatible = "google,stout", "intel,celeron-sandybridge";

	config {
	       hwid = "X86 STOUT TEST 8762";
	};

	chromeos-config {
		virtual-dev-switch;
		oprom-matters;
	};
};
