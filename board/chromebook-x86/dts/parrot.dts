/dts-v1/;

/include/ "coreboot.dtsi"
/include/ "chromeos-coreboot.dtsi"
/include/ "flashmap-coreboot-8mb_1mb_rom.dtsi"

/ {
	model = "Google Parrot";
	compatible = "google,parrot", "intel,celeron-sandybridge";

	config {
	       hwid = "X86 PARROT TEST 8762";
	};

	chromeos-config {
		virtual_dev_switch;
	};
};
