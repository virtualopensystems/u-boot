/dts-v1/;

/include/ "skeleton.dtsi"
/include/ "chromeos.dtsi"
/include/ "flashmap-4mb.dtsi"

/ {
	model = "Google Mario";
	compatible = "google,mario", "intel,atom-pineview";

	config {
	       hwid = "X86 MARIO TEST 1089";
	};
};
