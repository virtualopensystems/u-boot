/* Classical IO mapped 16550 UART */

/{
	aliases {
		console = "/serial@i3f8";
	};

	serial@i3f8 {
		compatible = "ns16550";
		reg = <0x3f8 0x08>;
		id = <1>;
		reg-shift = <1>;
		baudrate = <115200>;
		clock-frequency = <115200>;
		multiplier = <1>;
		io-mapped = <1>;
		status = "ok";
	};
};
