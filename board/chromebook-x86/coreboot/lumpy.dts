/dts-v1/;

/include/ "skeleton.dtsi"
/include/ "chromeos.dtsi"
/include/ "flashmap-4mb.dtsi"

/ {
	model = "Google Lumpy";
	compatible = "google,lumpy", "intel,celeron-sandybridge";

	config {
	       hwid = "X86 LUMPY TEST 6638";
	};

	flash@ffc00000 {
		bios-base = <0x400000>;
	};
};
