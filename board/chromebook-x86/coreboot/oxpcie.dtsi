/* OXPCIe 952 UART */

/ {
	aliases {
		console = "/serial@e0401000";
	};

	serial@e0401000 {
		compatible = "ns16550";
		reg = <0xe0401000 0x40>;
		id = <1>;
		reg-shift = <1>;
		baudrate = <115200>;
		clock-frequency = <4000000>;
		multiplier = <1>;
		status = "ok";
	};
};

